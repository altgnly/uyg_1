	__CONFIG H'3F31'
	LIST P = 16F877A
	#INCLUDE <P16F877A.INC>
	SAYI1 EQU 0X20
	SAYI2 EQU 0X21
	SONUC EQU 0X22
	SONUC_H EQU 0X23
	SONUC_L EQU 0X24
	ORG 0X00
	GOTO ANA_METOT

ANA_METOT
	BANKSEL TRISA
	MOVLW 0X06
	MOVWF ADCON1	;A PORTU AKTÝF HALE GETÝRÝLDÝ.
	MOVLW 0XFF
	MOVWF TRISA
	CLRF TRISB
	BANKSEL PORTA
	BSF PORTA,0
	CLRF PORTB
	
	MOVLW B'10101010'		;D'170'
	MOVWF SAYI1

	MOVLW B'11111111'		;D'255'
	MOVWF SAYI2

	CLRF SONUC_H
	CLRF SONUC_L

KONTROL
	MOVF SAYI1,W
	ADDWF SONUC_L,F
	BTFSC STATUS,C
	INCF SONUC_H,F
	BCF STATUS,C
	DECFSZ SAYI2,F
	GOTO KONTROL
	GOTO BUTON_KONTROL_H
	GOTO BUTON_KONTROL_L

BUTON_KONTROL_H
	BTFSC PORTA,0
	GOTO SONUC_H_GOSTER
	GOTO BUTON_KONTROL_L

BUTON_KONTROL_L	
	BTFSC PORTA,0
	GOTO SONUC_L_GOSTER
	GOTO BUTON_KONTROL_H

SONUC_H_GOSTER
	MOVF SONUC_H,W
	MOVWF PORTB
	GOTO BUTON_KONTROL_H

SONUC_L_GOSTER
	MOVF SONUC_L,W
	MOVWF PORTB
	GOTO BUTON_KONTROL_L

END	
